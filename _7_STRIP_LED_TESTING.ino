#define PIXELS 7
#define PIXEL_PORT  PORTD
#define PIXEL_DDR   DDRD
static const uint8_t onBits = 0b11111110;
#define T1H  814
#define T1L  438
#define T0H  312
#define T0L  936
#define RES 50000
#define NS_PER_SEC (1000000000L)
#define CYCLES_PER_SEC (F_CPU)
#define NS_PER_CYCLE ( NS_PER_SEC / CYCLES_PER_SEC )
#define NS_TO_CYCLES(n) ( (n) / NS_PER_CYCLE )
static inline void sendBitx8(  const uint8_t row , const uint8_t colorbyte , const uint8_t onBits ) {
  asm volatile (
    "L_%=: \n\r"
    "out %[port], %[onBits] \n\t"
    "mov r0, %[bitwalker] \n\t"
    "and r0, %[colorbyte] \n\t"
    "breq OFF_%= \n\t"
    "nop \n\t  "
    "out %[port], %[row]   \n\t"
    "nop \n\t nop \n\t "
    "nop \n\t nop \n\t "
    "nop \n\t nop \n\t "
    "nop \n\t "
    "out %[port], __zero_reg__ \n\t"
    "ror %[bitwalker] \n\t"
    "brcs DONE_%= \n\t"
    "nop \n\t \n\t "
    "jmp L_%= \n\t"
    "OFF_%=: \n\r"
    "out %[port], __zero_reg__ \n\t"
    "ror %[bitwalker] \n\t"
    "brcs DONE_%= \n\t"
    "nop \n\t nop \n\t "
    "nop \n\t nop \n\t "
    "nop \n\t nop \n\t "
    "nop \n\t nop \n\t "
    "nop \n\t "
    "jmp L_%= \n\t"
    "DONE_%=: \n\t"

    ::
    [port]    "I" (_SFR_IO_ADDR(PIXEL_PORT)),
    [row]   "d" (row),
    [onBits]   "d" (onBits),
    [colorbyte]   "d" (colorbyte ),
    [bitwalker] "r" (0x80)

  );

}

void show() {
  delayMicroseconds( (RES / 1000UL) + 1);
}

static inline void sendRowRGB( uint8_t row ,  uint8_t r,  uint8_t g,  uint8_t b ) {

  sendBitx8( row , g , onBits);
  sendBitx8( row , r , onBits);
  sendBitx8( row , b , onBits);

}

#define FONT_WIDTH 5
#define INTERCHAR_SPACE 1
#define ASCII_OFFSET 0x20

const uint8_t Font5x7[] PROGMEM = {
  0x00, 0x00, 0x00, 0x00, 0x00, //
  0x00, 0x00, 0xfa, 0x00, 0x00, // !
  0x00, 0xe0, 0x00, 0xe0, 0x00, // "
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  0x10, 0x38, 0x54, 0x10, 0x10, // 
};


static inline void sendChar( uint8_t c ,  uint8_t skip , uint8_t r,  uint8_t g,  uint8_t b ) {

  const uint8_t *charbase = Font5x7 + (( c - ' ') * FONT_WIDTH ) ;

  uint8_t col = FONT_WIDTH;

  while (skip--) {
    charbase++;
    col--;
  }

  while (col--) {
    sendRowRGB( pgm_read_byte_near( charbase++ ) , r , g , b );
  }

  col = INTERCHAR_SPACE;

  while (col--) {

    sendRowRGB( 0 , r , g , b );

  }

}

static inline void sendString( const char *s , uint8_t skip ,  const uint8_t r,  const uint8_t g,  const uint8_t b ) {

  unsigned int l = PIXELS / (FONT_WIDTH + INTERCHAR_SPACE);

  sendChar( *s , skip ,  r , g , b );   

  while ( *(++s) && l--) {

    sendChar( *s , 0,  r , g , b );

  }

  show();
}



void setup() {

  PIXEL_DDR |= onBits;        
}

static char text[] =
  " HELLO WORLD!"


  ;



void loop() {
  const char *m = text;

  while (*m) {

    for ( uint8_t step = 0; step < FONT_WIDTH + INTERCHAR_SPACE  ; step++ ) {
      cli();
      delay(10000);
//13000
      sendString( m , step , 0x244, 0x164 , 0x66 );   

      sei();


    }

    m++;

  }

}
